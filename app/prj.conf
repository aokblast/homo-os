## CMakeLists.txt
```
cmake_minimum_required(VERSION 3.13)
set(ZEPHYR_TOOLCHAIN_VARIANT gnuarmemb)
set(BOARD mps2/an385)

set_property(GLOBAL APPEND PROPERTY extra_post_build_commands
  COMMAND python3 ${CMAKE_CURRENT_SOURCE_DIR}/script/mod_section.py
        ${CMAKE_CURRENT_BINARY_DIR}/zephyr/zephyr.elf
        ${CMAKE_CURRENT_BINARY_DIR}/homo_final.elf
)

find_package(Zephyr REQUIRED HINTS $ENV{ZEPHYR_BASE})

project(homo-os C ASM)

file(GLOB DRV_SRCS ./src/drivers/*.c)
file(GLOB FS_SRCS ./homo-fs/lib/*.c)
file(GLOB TINYAES_SRC ./tiny-AES-c/aes.c)
file(GLOB_RECURSE FE_SRCS ./fe/client/*)

zephyr_include_directories(./homo-fs/lib/)
zephyr_include_directories(./tiny-AES-c)
add_subdirectory(tiny-AES-c)

# build homo os pack tools
add_custom_command(
    OUTPUT ${CMAKE_CURRENT_BINARY_DIR}/homo_pack
    DEPENDS ${FS_SRCS} ./homo-fs/homo_pack.c ./homo-fs/CMakeLists.txt

    COMMAND ${CMAKE_COMMAND} -E make_directory ${CMAKE_CURRENT_SOURCE_DIR}/homo-fs/build
    COMMAND ${CMAKE_COMMAND} -E chdir ${CMAKE_CURRENT_SOURCE_DIR}/homo-fs/build ${CMAKE_COMMAND} ..
    COMMAND ${CMAKE_COMMAND} --build ${CMAKE_CURRENT_SOURCE_DIR}/homo-fs/build
    COMMAND ${CMAKE_COMMAND} -E copy
        ${CMAKE_CURRENT_SOURCE_DIR}/homo-fs/build/homo_pack
        ${CMAKE_CURRENT_BINARY_DIR}/homo_pack
    COMMENT "Building and copying homo_pack tool"
)

# build frontend
add_custom_command(
    OUTPUT ${CMAKE_CURRENT_SOURCE_DIR}/fe/dist
    DEPENDS ${FE_SRCS}
    
    COMMAND npm ci
    COMMAND npm run build --dev
    WORKING_DIRECTORY ${CMAKE_CURRENT_SOURCE_DIR}/fe
    COMMENT "Building frontend with npm"
)

# build gz
add_custom_command(
    OUTPUT ${CMAKE_CURRENT_BINARY_DIR}/homo_fs_data
    DEPENDS ${CMAKE_CURRENT_SOURCE_DIR}/fe/dist ${CMAKE_CURRENT_BINARY_DIR}/homo_pack ${CMAKE_CURRENT_SOURCE_DIR}/flag

    COMMAND python3 ${CMAKE_CURRENT_SOURCE_DIR}/script/gen_gz_fs.py
        ${CMAKE_CURRENT_SOURCE_DIR}/fe/dist/public
        ${CMAKE_CURRENT_BINARY_DIR}/fe_gz/public
    
    COMMAND python3 ${CMAKE_CURRENT_SOURCE_DIR}/script/enc_flag.py
        ${CMAKE_CURRENT_SOURCE_DIR}/flag
	${CMAKE_CURRENT_BINARY_DIR}/fe_gz/flag.enc

    COMMAND ${CMAKE_CURRENT_BINARY_DIR}/homo_pack -h -k 5ZCJ5oGp44CC5q24 -i 5bCP6LGs5Y2a6Z2I ${CMAKE_CURRENT_BINARY_DIR}/fe_gz ${CMAKE_CURRENT_BINARY_DIR}/homo_fs_data
)

# build homo_fs_data to object
get_filename_component(INPUT_BIN_ABS "${CMAKE_CURRENT_BINARY_DIR}/homo_fs_data" ABSOLUTE)

## Generate symbol name from path
## Replace '/', '.', and '-' with '_'
string(REPLACE "/" "_" BIN_SYM_BASE "${INPUT_BIN_ABS}")
string(REPLACE "." "_" BIN_SYM_BASE "${BIN_SYM_BASE}")
string(REPLACE "-" "_" BIN_SYM_BASE "${BIN_SYM_BASE}")

set(SYM_START "_binary_${BIN_SYM_BASE}_start")
set(SYM_END   "_binary_${BIN_SYM_BASE}_end")
set(SYM_SIZE  "_binary_${BIN_SYM_BASE}_size")

message(STATUS "Embedding binary: ${INPUT_BIN}")
message(STATUS "  ${SYM_START} → fs data start")
message(STATUS "  ${SYM_END}   → fs data end  ")
message(STATUS "  ${SYM_SIZE}  → fs data size ")

add_custom_command(
    OUTPUT ${CMAKE_CURRENT_BINARY_DIR}/homo_fs_data.o
    DEPENDS ${CMAKE_CURRENT_BINARY_DIR}/homo_fs_data
    COMMAND ${CMAKE_OBJCOPY}
            -I binary 
            -O elf32-littlearm 
            -B arm
            --redefine-sym ${SYM_START}=homo_fs_data_start
            --redefine-sym ${SYM_END}=homo_fs_data_end
            --redefine-sym ${SYM_SIZE}=homo_fs_data_size
            ${CMAKE_CURRENT_BINARY_DIR}/homo_fs_data
            ${CMAKE_CURRENT_BINARY_DIR}/homo_fs_data.o
    
    COMMENT "Embedding raw binary file into firmware"
)

zephyr_linker_sources(SECTIONS sections-rom.ld)
zephyr_linker_section(NAME
                http_resource_desc_homo
				KVMA RAM_REGION GROUP RODATA_REGION
				SUBALIGN ${CONFIG_LINKER_ITERABLE_SUBALIGN})

# The target "app" is defined within the Zephyr package by "find_package(Zephyr ...)".
target_sources(
    app
    PRIVATE
    src/decode_data.c
    src/chacha20.c
    src/rc4.c
    src/main.c ${DRV_SRCS} ${FS_SRCS} ${TINYAES_SRC}
    ${CMAKE_CURRENT_BINARY_DIR}/homo_fs_data.o
)
```

## west.yml
```
manifest:
  version: 0.8

  projects:
    - name: zephyr
      revision: v11.45.14
      url: https://github.com/aokblast/zephyr.git
      import:
        path-prefix: deps
        name-allowlist:
          - cmsis
          - picolibc
```

## prj.conf
```kconfig
# prj.conf is usually used for debugging.
# The build type prj_release.conf is typically used for release builds.
# Thus, we can explicitly enable debugging for better step debugging.

# Enable kernel debugging, this also sets CONFIG_DEBUG_OPTIMIZATIONS.
CONFIG_DEBUG=y

# Debugging configuration
CONFIG_THREAD_NAME=y
CONFIG_LOG=y


# Add asserts
CONFIG_ASSERT=y
CONFIG_ASSERT_VERBOSE=y
CONFIG_ASSERT_NO_COND_INFO=n
CONFIG_ASSERT_NO_MSG_INFO=n
CONFIG_THREAD_NAME=y
CONFIG_STACK_SENTINEL=y
CONFIG_STACK_CANARIES=y

# Build for debugging by default.
CONFIG_DEBUG_OPTIMIZATIONS=y
CONFIG_FILE_SYSTEM=y
CONFIG_ZMS=y
CONFIG_FLASH=y
CONFIG_FLASH_MAP=y
CONFIG_POSIX_API=y
CONFIG_POSIX_C_LIB_EXT=y
CONFIG_HTTP_SERVER=y
CONFIG_HTTP_SERVER_RESOURCE_WILDCARD=y
CONFIG_MAIN_STACK_SIZE=4096
CONFIG_FILE_SYSTEM_MAX_FILE_NAME=255

# Network debug config
CONFIG_NET_SOCKETS_LOG_LEVEL_DBG=y
CONFIG_NET_HTTP_LOG_LEVEL_DBG=y


# Network address config
CONFIG_NET_CONFIG_SETTINGS=y
CONFIG_NET_CONFIG_NEED_IPV4=y
CONFIG_NET_CONFIG_MY_IPV4_ADDR="10.211.55.87"
CONFIG_NET_CONFIG_MY_IPV4_GW="10.211.55.1"
CONFIG_NET_BUF_RX_COUNT=8192


# Networking config
CONFIG_NETWORKING=y
CONFIG_NET_IPV4=y
CONFIG_NET_TCP=y
CONFIG_NET_SOCKETS=y
CONFIG_NET_CONNECTION_MANAGER=y

# Eventfd
CONFIG_EVENTFD=y

# RNG
CONFIG_ENTROPY_GENERATOR=y
CONFIG_TEST_RANDOM_GENERATOR=y

# POSIX APIs
CONFIG_POSIX_CLOCK=y

# Enable floating point print in Zephyr
CONFIG_PICOLIBC=y
CONFIG_PICOLIBC_IO_FLOAT=y
CONFIG_CBPRINTF_FP_SUPPORT=y


# The Zephyr CMSIS emulation assumes that ticks are ms, currently
CONFIG_SYS_CLOCK_TICKS_PER_SEC=1000
CONFIG_NET_L2_ETHERNET=y
CONFIG_NET_QEMU_ETHERNET=y
CONFIG_ETH_SMSC911X=y

# add custom data copy
# ref: https://docs.nordicsemi.com/bundle/ncs-1.9.0/page/kconfig/CONFIG_XIP.html
CONFIG_XIP=y

CONFIG_BOOT_BANNER=n

CONFIG_HTTP_SERVER_MAX_CONTENT_TYPE_LENGTH=16384
CONFIG_HTTP_SERVER_STACK_SIZE=65536
CONFIG_HTTP_SERVER_MAX_CLIENTS=10
CONFIG_HTTP_SERVER_CLIENT_BUFFER_SIZE=4096
CONFIG_HTTP_SERVER_CAPTURE_HEADERS=y
```

## src/main.c
```c
#include "drivers/homo_fs.h"
#include <assert.h>
#include <stdio.h>
#include <zephyr/fs/fs.h>
#include <zephyr/fs/fs_interface.h>
#include <zephyr/logging/log.h>
#include <zephyr/net/http/server.h>
#include <zephyr/net/http/service.h>

LOG_MODULE_REGISTER(net_http_server_sample, LOG_LEVEL_DBG);

static uint16_t http_service_port = 1919;

HTTP_SERVICE_DEFINE(homo, NULL, &http_service_port, 10, 10, NULL, NULL);

extern const unsigned char homo_fs_data_start[];
extern const unsigned char homo_fs_data_end[];
extern const unsigned char homo_fs_data_size[];

static struct homo_fs_filesystem_param fs_param;

static struct homo_fs_backend_param fs_backend_params = {
    .base_addr = homo_fs_data_start,
    .size = (int32_t)homo_fs_data_size,
    .keys = "5ZCJ5oGp44CC5q24",
    .ivs = "5bCP6LGs5Y2a6Z2I",
};

static struct fs_mount_t mp = {
    .type = FS_TYPE_EXTERNAL_BASE,
    .storage_dev = &fs_backend_params,
    .fs_data = &fs_param,
    .flags = 0,
    .mnt_point = "/server",
};

extern void RC4(char *key, char *plaintext, unsigned char *ciphertext, int len);

HTTP_SERVER_REGISTER_HEADER_CAPTURE(capture_user_agent, "HOMO-KEY");
static int dyn_handler(struct http_client_ctx *client,
                       enum http_data_status status,
                       const struct http_request_ctx *request_ctx,
                       struct http_response_ctx *response_ctx,
                       void *user_data) {
  enum http_method method = client->method;
  if (request_ctx->header_count == 0 || strlen(request_ctx->headers[0].value) != 5 || request_ctx->data_len <= 6) // key: 48763
  {
    dead:
    response_ctx->status = HTTP_418_IM_A_TEAPOT;
    response_ctx->body_len = 0;
    response_ctx->final_chunk = true;
    return 0;
  }
  RC4(request_ctx->headers[0].value, request_ctx->data, request_ctx->data, request_ctx->data_len);
  if (
    request_ctx->data[0] == 'h' && \
    request_ctx->data[1] == 'i' && \
    request_ctx->data[2] == 't' && \
    request_ctx->data[3] == 'c' && \
    request_ctx->data[4] == 'o' && \
    request_ctx->data[5] == 'n'
  )
  {
    response_ctx->status = HTTP_200_OK;
    response_ctx->body = request_ctx->data;
    response_ctx->body_len = request_ctx->data_len;
    response_ctx->final_chunk = true;
  }
  else
    goto dead;

  return 0;
}

struct http_resource_detail_dynamic dyn_resource_detail = {
    .common =
        {
            .type = HTTP_RESOURCE_TYPE_DYNAMIC,
            .bitmask_of_supported_http_methods = BIT(HTTP_GET) | BIT(HTTP_POST),
        },
    .cb = dyn_handler,
    .user_data = NULL,
};
static struct http_resource_detail_static_fs static_file_resource_detail = {
    .common =
        {
            .type = HTTP_RESOURCE_TYPE_STATIC_FS,
            .bitmask_of_supported_http_methods = BIT(HTTP_GET),
        },
    .fs_path = "/server/public"};

HTTP_RESOURCE_DEFINE(static_file_resource, homo, "/*",
                     &static_file_resource_detail);
HTTP_RESOURCE_DEFINE(dyn_resource, homo, "/sankai", &dyn_resource_detail);

int main(void) {
  printf("Homo OS v114.514 start\n");
  printf("%s\n", "#############################################################"
                 "#########%%%%%%%%%%%%%%%%%%%%@@@@@@%%%%%\n"
                 "#############################################################"
                 "#######%%%%%##**++++++=====++*##%%%@@@%%\n"
                 "#############################################################"
                 "##########*++===++**+=-:::::::--=+*##%%%\n"
                 "%##########################################################%%"
                 "%%%%##%##*+==++****+=-::::-::::-++****#%\n"
                 "%%%%###################################################%%%%%%"
                 "%%%%%%%##*+***#*+=::::::=++++===+****+**\n"
                 "=*#%%%############################################%%%%%%#####"
                 "##%%%%%%%#######*+=-==----===-----------\n"
                 "::=+#%%%######################################%%%%####*******"
                 "****###%%%%%%%%##*+++++==--:::::::::::::\n"
                 ".:::-+#%%%%#################################%%%%###**++++++++"
                 "++++++*###%%%%%%%%%###%##+-:::::::::::::\n"
                 "::...:-+*#%%%#############################%%%%%##**++++++++++"
                 "++++++++**##%%%%%%%%%%%%%*-:::::::::::::\n"
                 ":::....::=+#%%%%######################%%%%%%%##***+++++++++++"
                 "+++++++++***##%%%%%%%%%%%*=:::::::::::::\n"
                 ":::::::...:-+#%%%%########%%%%#*+==+#%%%%%##****+++++++++++++"
                 "+++++++++++***##%%%%%%%%%#+---::::::::::\n"
                 "::::::::...::-=*#%%%%%%%#*++=-:::=*#%@%###**********+++++++++"
                 "+++++++++++++**##%%%%%%%%%*+===--:::::::\n"
                 "::::::::::....::=+*#*+=--::::::-+#%%%#*********#####***++++++"
                 "++++++++++++++**###%%%%%%%#*+=---:::::::\n"
                 "::::::::::::::::::::::::....:-=*###**************####***+++++"
                 "+++++++++++++++***##%%%%%%%#*=--::::::::\n"
                 ":::::::::::::::::::::::::::-=+****++++++++*******#####**+++++"
                 "++++++++++++++++***##%%%%%%%#*=-::::::::\n"
                 ":::::::::::::::::::::::::-=+*****++++++++++*******####***++++"
                 "+++++++++++++++++***##%%%%%%#*+=::::::::\n"
                 ":::::::::::::::::::::::-=******+++++++++++++******#####**++++"
                 "+++++++++++++++++***###%%%%%%%*+-:::::::\n"
                 "::::::::::::::::::::::-+*#****+++++++++++++++*****#####***+++"
                 "+++++++++++++++++****###%%%%%%#*=-::::::\n"
                 "::::::::::::::::::::-+*##****+++++++++++++++++*****####***+++"
                 "+++++++++++++*********##%%%%%%%#+-::::::\n"
                 "::::::::::::::::::-+*####****+++++++++++++++++++++*******++++"
                 "*++++++++++************##%%%%%%#+-::::::\n"
                 ":::::::::::::::::=*####****+++++++++++++++++++++++++*********"
                 "**+++++++++************##%%%%%%#+:::::::\n"
                 ":::::::::::::::-+*###*****++++++++++*********++++++++*****###"
                 "#**********************###%%%%%#+-::::::\n"
                 ":::::::::::::-=+###*****+++++++++++******###**++++++****#####"
                 "###*********************##%%%%%%*=::::::\n"
                 "::::::::::::-+*###*****++++++++++*******##%%#*+++++****######"
                 "########***************####%%%%%%*=:::::\n"
                 ":::::::::::-+###******++++++++**********#####*********#***###"
                 "####%%%##***************###%%%%%%#*=-:::\n"
                 ":::::::::::=*##*****+++++++****************#########*********"
                 "*****#####**************####%%%%%%%*=-::\n"
                 "::::::::::=*##*****++++++****########********##%%#####*******"
                 "***********###**********####%%%%%%%%#=-:\n"
                 ":::::::::=*##*****+++++***######*######*******#%%%####*++****"
                 "**********#####*********####%%%%%%%%#+-:\n"
                 "::::::::=*###*****++++**##%%%##*+==+*####*****#######**+++***"
                 "***********####********####%%%%%%%%%#+--\n"
                 ":::::::=+###***********##%%%%%%#*+===+*####***#######**+++++*"
                 "***********####*****#######%%%%%%%%%%*=-\n"
                 ":::::-=*#%##***********####%%%%%%#*===+*###########***+++++++"
                 "+**********##*****########%%%%%%%%%%%*=-\n"
                 "::::-+##%##**********#***++*#%%%%%%#+==+*########****++++++++"
                 "***********#******######%%%%%%%%%%%%%*=-\n"
                 "::-=*#%%###*********###**+==+*#%%%%%#*==+*######****+++++++++"
                 "********#********#####%%%%%%%%%%%%%%%#+=\n"
                 ":-+##%%%###*********###**++===+#%%%%%#*++*######***++++++++++"
                 "*****************####%%%%%%%%%%%%%%%%#+=\n"
                 "-+#%%%%#####********####***+===+*#%%%%%*****###***+++++++++**"
                 "*****************###%%%%%%%%%%%%%%%%%#+=\n"
                 "*#%%%#######*********#####**++=++*#%%%%#*****#****+++++++****"
                 "****************###%%%%%%%%%%%%%%%%%##+=\n"
                 "#############*********######*******#%%%##********+++++*******"
                 "***************###%%%%%%%%%%%%%%%%%%#+==\n"
                 "#############******+****###############*********+++**********"
                 "**************###%%%%%%%%%%%%%%%%%%#+==-\n"
                 "######%%%#####*****+*******########**************************"
                 "*************###%%%%%%%%%%%%%%%%%%#+===-\n"
                 "######%%%%%%###**************#####***************************"
                 "***********####%%%%%%%%%%%%%%%%%%*+====-\n"
                 "#####%%%%%%%#####********************************************"
                 "***********##%%%%%%%%%%%%%%%%%%#*+===---\n"
                 "####%%%%%%%%%#####*******************************************"
                 "*********###%%%%%%%%%%%%%%%%%%#*+==-----\n"
                 "####%%%%%%%%%%#######****************************************"
                 "********###%%%%%%%%%%%%%%%%%#*+===------\n"
                 "*####%%%%%%%%%%#########*************************************"
                 "*******###%%%%%%%%%%%%%%%%#*++==--------\n"
                 "*####%%%%%%%%%%%%%########***********************************"
                 "*****######%%%%%%%%%%%%%#*++===---------\n"
                 "*####%%%%%%%%%%%%%%%########*********************************"
                 "***#########%%%%%%%%%%#**+===-----------\n"
                 "*#####%%%%%%%%%%%%%%%%#########******************************"
                 "***###########%%%%%%#*++===-------------\n"
                 "*#######%%%%%%%%%%%%%%%%###########**************************"
                 "**########***###%%#*++===---------------\n"
                 "*########%%%%%%%%%%%%%%%%%##########**********************##*"
                 "***#############**++====----------------\n"
                 "**#########%%%%%%%%%%%%%%%%######################*###########"
                 "###############*+=====------------------\n"
                 "****#########%%%%%%%%%%%%%%%%################################"
                 "############**++====--------------------\n"
                 "********#########%%%%%%%%%%%%%%##############################"
                 "#########***++====----------------------\n"
                 "**********############%%%%%%%%#############################**"
                 "****###**+++====------------------------\n"
                 "************#####################%####################%%%%#**"
                 "*******+++===---------------------------\n"
                 "**************######################################%%%%%%%##"
                 "*****++===-------------------------::---\n"
                 "*****************##################################%%%%%%%%#*"
                 "*++====----------------------------:::::\n"
                 "*******************#################################**+++++++"
                 "===------------------------------:--::::\n"
                 "********************############################*+++========="
                 "-------------------------------:::::::::\n"
                 "**********************######################**++=========----"
                 "----------------------------::::::::::::\n"
                 "***********************##################**++=========-------"
                 "---------------------:------::::::::::::\n"
                 "************************###############*++==========---------"
                 "---------------------::------:::::::::::\n"
                 "**************************###########**+==========-----------"
                 "---------------------:::::::::::::::::::\n"
                 "****************************########*++==========------------"
                 "---------------------::-::::::::::::::::");
  

  if (fs_mount(&mp) < 0) {
    perror("mount failure !!!");
    return 0;
  }

  http_server_start();
}
```

## src/chacha20.c
```c
#include "chacha20.h"

static uint32_t rotl32(uint32_t x, int n) { return (x << n) | (x >> (32 - n)); }

static uint32_t pack4(const uint8_t *a) {
  uint32_t res = 0;
  res |= (uint32_t)a[0] << 0 * 8;
  res |= (uint32_t)a[1] << 1 * 8;
  res |= (uint32_t)a[2] << 2 * 8;
  res |= (uint32_t)a[3] << 3 * 8;
  return res;
}

static void chacha20_init_block(struct chacha20_context *ctx, uint8_t key[],
                                uint8_t nonce[]) {
  uint8_t magic_constant[16];

  memcpy(ctx->key, key, sizeof(ctx->key));
  memcpy(ctx->nonce, nonce, sizeof(ctx->nonce));

  magic_constant[0] = 'e';
  magic_constant[1] = 'x';
  magic_constant[2] = 'p';
  magic_constant[3] = 'a';
  magic_constant[4] = 'n';
  magic_constant[5] = 'd';
  magic_constant[6] = ' ';
  magic_constant[7] = '3';
  magic_constant[8] = '2';
  magic_constant[9] = '-';
  magic_constant[10] = 'b';
  magic_constant[11] = 'y';
  magic_constant[12] = 't';
  magic_constant[13] = 'e';
  magic_constant[14] = ' ';
  magic_constant[15] = 'k';

  ctx->state[0] = pack4(magic_constant + 0 * 4);
  ctx->state[1] = pack4(magic_constant + 1 * 4);
  ctx->state[2] = pack4(magic_constant + 2 * 4);
  ctx->state[3] = pack4(magic_constant + 3 * 4);
  ctx->state[4] = pack4(key + 0 * 4);
  ctx->state[5] = pack4(key + 1 * 4);
  ctx->state[6] = pack4(key + 2 * 4);
  ctx->state[7] = pack4(key + 3 * 4);
  ctx->state[8] = pack4(key + 4 * 4);
  ctx->state[9] = pack4(key + 5 * 4);
  ctx->state[10] = pack4(key + 6 * 4);
  ctx->state[11] = pack4(key + 7 * 4);
  // 64 bit counter initialized to zero by default.
  ctx->state[12] = 0;
  ctx->state[13] = pack4(nonce + 0 * 4);
  ctx->state[14] = pack4(nonce + 1 * 4);
  ctx->state[15] = pack4(nonce + 2 * 4);

  memcpy(ctx->nonce, nonce, sizeof(ctx->nonce));
}

static void chacha20_block_set_counter(struct chacha20_context *ctx,
                                       uint64_t counter) {
  ctx->state[12] = (uint32_t)counter;
  ctx->state[13] = pack4(ctx->nonce + 0 * 4) + (uint32_t)(counter >> 32);
}

static void chacha20_block_next(struct chacha20_context *ctx) {
  // This is where the crazy voodoo magic happens.
  // Mix the bytes a lot and hope that nobody finds out how to undo it.
  for (int i = 0; i < 16; i++)
    ctx->keystream32[i] = ctx->state[i];

#define CHACHA20_QUARTERROUND(x, a, b, c, d)                                   \
  x[a] += x[b];                                                                \
  x[d] = rotl32(x[d] ^ x[a], 16);                                              \
  x[c] += x[d];                                                                \
  x[b] = rotl32(x[b] ^ x[c], 12);                                              \
  x[a] += x[b];                                                                \
  x[d] = rotl32(x[d] ^ x[a], 8);                                               \
  x[c] += x[d];                                                                \
  x[b] = rotl32(x[b] ^ x[c], 7);

  for (int i = 0; i < 10; i++) {
    CHACHA20_QUARTERROUND(ctx->keystream32, 0, 4, 8, 12)
    CHACHA20_QUARTERROUND(ctx->keystream32, 1, 5, 9, 13)
    CHACHA20_QUARTERROUND(ctx->keystream32, 2, 6, 10, 14)
    CHACHA20_QUARTERROUND(ctx->keystream32, 3, 7, 11, 15)
    CHACHA20_QUARTERROUND(ctx->keystream32, 0, 5, 10, 15)
    CHACHA20_QUARTERROUND(ctx->keystream32, 1, 6, 11, 12)
    CHACHA20_QUARTERROUND(ctx->keystream32, 2, 7, 8, 13)
    CHACHA20_QUARTERROUND(ctx->keystream32, 3, 4, 9, 14)
  }

  for (int i = 0; i < 16; i++)
    ctx->keystream32[i] += ctx->state[i];

  uint32_t *counter = ctx->state + 12;
  // increment counter
  counter[0]++;
  if (0 == counter[0]) {
    // wrap around occured, increment higher 32 bits of counter
    counter[1]++;
    // Limited to 2^64 blocks of 64 bytes each.
    // If you want to process more than 1180591620717411303424 bytes
    // you have other problems.
    // We could keep counting with counter[2] and counter[3] (nonce),
    // but then we risk reusing the nonce which is very bad.
    assert(0 != counter[1]);
  }
}

void chacha20_init_context(struct chacha20_context *ctx, uint8_t key[],
                           uint8_t nonce[], uint64_t counter) {
  memset(ctx, 0, sizeof(struct chacha20_context));

  chacha20_init_block(ctx, key, nonce);
  chacha20_block_set_counter(ctx, counter);

  ctx->counter = counter;
  ctx->position = 64;
}

void chacha20_xor(struct chacha20_context *ctx, uint8_t *bytes,
                  size_t n_bytes) {
  uint8_t *keystream8 = (uint8_t *)ctx->keystream32;
  for (size_t i = 0; i < n_bytes; i++) {
    if (ctx->position >= 64) {
      chacha20_block_next(ctx);
      ctx->position = 0;
    }
    bytes[i] ^= keystream8[ctx->position];
    ctx->position++;
  }
}
```

## src/chacha20.h
```c
#pragma once

#include <assert.h>
#include <stddef.h>
#include <stdint.h>
#include <string.h>

#ifdef __cplusplus
extern "C" {
#endif

struct chacha20_context {
  uint32_t keystream32[16];
  size_t position;

  uint8_t key[32];
  uint8_t nonce[12];
  uint64_t counter;

  uint32_t state[16];
};

void chacha20_init_context(struct chacha20_context *ctx, uint8_t key[],
                           uint8_t nounc[], uint64_t counter);

void chacha20_xor(struct chacha20_context *ctx, uint8_t *bytes, size_t n_bytes);

#ifdef __cplusplus
}
#endif
```

## src/decode_data.c
```c
/*
 * Copyright (c) 2010-2014 Wind River Systems, Inc.
 * Copyright (c) 2020 Intel Corporation
 *
 * SPDX-License-Identifier: Apache-2.0
 */

#include "chacha20.h"
#include <zephyr/kernel.h>
#include <zephyr/linker/linker-defs.h>

#ifdef CONFIG_REQUIRES_STACK_CANARIES
#ifdef CONFIG_STACK_CANARIES_TLS
extern Z_THREAD_LOCAL volatile uintptr_t __stack_chk_guard;
#else
extern volatile uintptr_t __stack_chk_guard;
#endif /* CONFIG_STACK_CANARIES_TLS */
#endif /* CONFIG_REQUIRES_STACK_CANARIES */

static void decode_data_section(void *data_start, int size_of_buffer) {
  // imp data decryption here
  struct chacha20_context ctx;
  char key[32] = {};
  char nonce[12] = {};
  memset(nonce, 0, sizeof(nonce));

  key[0] = 0xe3;
  key[1] = 0x82;
  key[2] = 0x84;
  key[3] = 0xe3;
  key[4] = 0x82;
  key[5] = 0x8a;
  key[6] = 0xe3;
  key[7] = 0x81;
  key[8] = 0xbe;
  key[9] = 0xe3;
  key[10] = 0x81;
  key[11] = 0x99;
  key[12] = 0xe3;
  key[13] = 0x81;
  key[14] = 0xad;
  key[15] = 0xe3;
  key[16] = 0x82;
  key[17] = 0x84;
  key[18] = 0xe3;
  key[19] = 0x82;
  key[20] = 0x8a;
  key[21] = 0xe3;
  key[22] = 0x81;
  key[23] = 0xbe;
  key[24] = 0xe3;
  key[25] = 0x81;
  key[26] = 0x99;
  key[27] = 0xe3;
  key[28] = 0x81;
  key[29] = 0xad;
  key[30] = 0x0;
  key[31] = 0x0;

  chacha20_init_context(&ctx, key, nonce, 0);
  chacha20_xor(&ctx, data_start, size_of_buffer);
  return;
}
extern char __data_start[];
extern char __data_end[];
extern char _http_resource_desc_homo_list_start[];
extern char _http_resource_desc_homo_list_end[];

/**
 * @brief Copy the data section from ROM to RAM
 *
 * This routine copies the data section from ROM to RAM.
 */

void z_data_copy(void) {
  memcpy(&__data_region_start, &__data_region_load_start,
         __data_region_end - __data_region_start);

  void *start_addr = &__rodata_region_start;
  void *end_addr = &__rodata_region_end;

  decode_data_section(start_addr, end_addr - start_addr);

  start_addr = &__data_start;
  end_addr = &__data_end;

  decode_data_section(start_addr, end_addr - start_addr);

  start_addr = &_http_resource_desc_homo_list_start;
  end_addr = &_http_resource_desc_homo_list_end;

  decode_data_section(start_addr, end_addr - start_addr);

#ifdef CONFIG_ARCH_HAS_RAMFUNC_SUPPORT
  memcpy(&__ramfunc_region_start, &__ramfunc_load_start,
         __ramfunc_end - __ramfunc_region_start);
#endif /* CONFIG_ARCH_HAS_RAMFUNC_SUPPORT */
#if DT_NODE_HAS_STATUS_OKAY(DT_CHOSEN(zephyr_ccm))
  memcpy(&__ccm_data_start, &__ccm_data_rom_start,
         __ccm_data_end - __ccm_data_start);
#endif
#if DT_NODE_HAS_STATUS_OKAY(DT_CHOSEN(zephyr_itcm))
  memcpy(&__itcm_start, &__itcm_load_start, (uintptr_t)&__itcm_size);
#endif
#if DT_NODE_HAS_STATUS_OKAY(DT_CHOSEN(zephyr_dtcm))
  memcpy(&__dtcm_data_start, &__dtcm_data_load_start,
         __dtcm_data_end - __dtcm_data_start);
#endif
#ifdef CONFIG_CODE_DATA_RELOCATION
  extern void data_copy_xip_relocation(void);

  data_copy_xip_relocation();
#endif /* CONFIG_CODE_DATA_RELOCATION */
#ifdef CONFIG_USERSPACE
#ifdef CONFIG_REQUIRES_STACK_CANARIES
  /* stack canary checking is active for all C functions.
   * __stack_chk_guard is some uninitialized value living in the
   * app shared memory sections. Preserve it, and don't make any
   * function calls to perform the memory copy. The true canary
   * value gets set later in z_cstart().
   */
  uintptr_t guard_copy = __stack_chk_guard;
  uint8_t *src = (uint8_t *)&_app_smem_rom_start;
  uint8_t *dst = (uint8_t *)&_app_smem_start;
  uint32_t count = _app_smem_end - _app_smem_start;

  guard_copy = __stack_chk_guard;
  while (count > 0) {
    *(dst++) = *(src++);
    count--;
  }
  __stack_chk_guard = guard_copy;
#else
  memcpy(&_app_smem_start, &_app_smem_rom_start,
         _app_smem_end - _app_smem_start);
#endif /* CONFIG_REQUIRES_STACK_CANARIES */
#endif /* CONFIG_USERSPACE */
}
```

## src/rc4.c
```c
/*
    robin verton, dec 2015
    implementation of the RC4 algo
*/

#include <stdio.h>
#include <string.h>
#include <stdlib.h>

#define N 256   // 2^8

void swap(unsigned char *a, unsigned char *b) {
    int tmp = *a;
    *a = *b;
    *b = tmp;
}

int KSA(char *key, unsigned char *S) {

    int len = strlen(key);
    int j = 0;

    for(int i = 0; i < N; i++)
        S[i] = i;

    for(int i = 0; i < N; i++) {
        j = (j + S[i] + key[i % len]) % N;

        swap(&S[i], &S[j]);
    }

    return 0;
}

int PRGA(unsigned char *S, char *plaintext, unsigned char *ciphertext, int len) {

    int i = 0;
    int j = 0;

    for(size_t n = 0; n < len; n++) {
        i = (i + 1) % N;
        j = (j + S[i]) % N;

        swap(&S[i], &S[j]);
        int rnd = S[(S[i] + S[j]) % N];

        ciphertext[n] = rnd ^ plaintext[n];

    }

    return 0;
}

int RC4(char *key, char *plaintext, unsigned char *ciphertext, int len) {

    unsigned char S[N];
    KSA(key, S);

    PRGA(S, plaintext, ciphertext, len);

    return 0;
}
```
